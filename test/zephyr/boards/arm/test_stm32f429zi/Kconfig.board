## test/zephyr/boards/arm/test_stm32f429zi/Kconfig.board
```kconfig
# test_stm32f429zi board configuration

config BOARD_TEST_STM32F429ZI
    bool "STM32F429ZI LVGL Test Board"
    depends on SOC_STM32F429XX
```

## test/zephyr/boards/arm/test_stm32f429zi/Kconfig.defconfig
```kconfig
if BOARD_TEST_STM32F429ZI

config BOARD
    default "test_stm32f429zi"

if NETWORKING

config NET_L2_ETHERNET
	default y

config ETH_STM32_HAL
	default y

endif # NETWORKING

endif # BOARD_TEST_STM32F429ZI
```
